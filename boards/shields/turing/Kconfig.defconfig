## boards/shields/turing/Kconfig.defconfig
```kconfig
# Copyright (c) 2020 Pete Johanson, Kurtis Lew
# SPDX-License-Identifier: MIT

if SHIELD_Turing_LEFT

config ZMK_KEYBOARD_NAME
    default "Turing"

config ZMK_SPLIT_ROLE_CENTRAL
    default y

endif

if SHIELD_TURING_LEFT || SHIELD_TURING_RIGHT

config ZMK_SPLIT
    default y

endif
```

## boards/shields/turing/Kconfig.shield
```kconfig
# Copyright (c) 2020 Pete Johanson, Kurtis Lew
# SPDX-License-Identifier: MIT

config SHIELD_TURING_LEFT
    def_bool $(shields_list_contains,turing_left)

config SHIELD_TURING_RIGHT
    def_bool $(shields_list_contains,turing_right)
```
